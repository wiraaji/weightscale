/*
  Program Timbangan
*/

#include <MCUFRIEND_kbv.h>
#include <Adafruit_GFX.h>
#include <HX711.h>
#include <SoftwareSerial.h>
#include <EEPROM.h>

#define TX_PIN 13  // Connect to printer RX
#define RX_PIN 12  // Connect to printer TX

#define DOUT 10
#define CLK 11
#define BUZZER 1
#define BTN_PIN A5

MCUFRIEND_kbv tft;
HX711 scale;
SoftwareSerial PRINTER(RX_PIN, TX_PIN);  // RX, TX

int NYALA = HIGH;
int MATI = LOW;
float CALIBRATION_WEIGHT = 200;
float calibration_factor = 58.67;
const int EEPROM_ADDRESS = 0;
unsigned long buttonPressStartTime = 0;
bool buttonPressed = false;

// int BATAS_ATAS = 7110;
// int BATAS_BAWAH = 6900;

int BATAS_ATAS = 210;
int BATAS_BAWAH = 190;

const unsigned char nsi_logo[] PROGMEM = {
  0xff, 0xff, 0xff, 0xff, 0xff, 0xff, 0xff, 0xff, 0xff, 0xff, 0xff, 0xff, 0xff, 0xff, 0xff, 0xff,
  0xff, 0xff, 0xff, 0xff, 0xff, 0xff, 0xff, 0xff, 0xff, 0xff, 0xff, 0xff, 0xff, 0xff, 0xff, 0xff,
  0xff, 0xff, 0xff, 0xff, 0xff, 0xff, 0xff, 0xff, 0xff, 0xff, 0xff, 0xff, 0xff, 0xff, 0xff, 0xff,
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  0xff, 0xff, 0xff, 0xff, 0xff, 0xff, 0xff, 0xff
};

void setup() {
  // Serial.begin(9600);  // Inisialisasi serial untuk debug
  uint16_t ID = tft.readID();
  tft.begin(ID);
  tft.fillScreen(TFT_BLACK);
  tft.drawBitmap(60, 100, nsi_logo, 120, 200, TFT_WHITE);
  delay(2000);
  tft.fillScreen(TFT_BLACK);
  tft.setRotation(-1);
  tft.fillScreen(TFT_BLACK);

  tft.setTextColor(TFT_WHITE);
  tft.setTextSize(3);
  tft.setCursor(10, 10);
  tft.print("Initializing...");

  scale.begin(DOUT, CLK);

  // Baca nilai calibration_factor dari EEPROM
  EEPROM.get(EEPROM_ADDRESS, calibration_factor);

  scale.set_scale(calibration_factor);
  scale.tare();

  tft.fillScreen(TFT_BLACK);
  tft.setCursor(10, 10);
  tft.setTextSize(3);
  tft.print("Taring scale...");
  delay(1000);

  tft.fillScreen(TFT_BLACK);

  pinMode(BUZZER, OUTPUT);
  pinMode(BTN_PIN, INPUT_PULLUP);

  PRINTER.begin(9600);
  tft.fillRect(10, 10, 300, 30, TFT_BLACK);  // Bersihkan area pesan
}

void calibrateScale() {
  tft.fillScreen(TFT_BLACK);
  tft.setCursor(105, 10);
  tft.setTextSize(2);
  tft.print("Mengkalibrasi");
  delay(500);
  tft.setCursor(80, 30);
  tft.print("Kosongkan Timbangan");
  countdown(4000);  // 5 seconds countdown
  scale.tare();

  tft.fillScreen(TFT_BLACK);
  tft.setCursor(45, 40);
  tft.print("Tempatkan Benda ");
  tft.print(CALIBRATION_WEIGHT);
  tft.print(" gram");
  delay(7000);  // 3 seconds

  tft.setCursor(110, 60);
  tft.print("Sedang Proses");
  long reading = scale.get_value(10);
  calibration_factor = reading / CALIBRATION_WEIGHT;
  scale.set_scale(calibration_factor);
  // Simpan nilai calibration_factor ke EEPROM
  EEPROM.put(EEPROM_ADDRESS, calibration_factor);
  delay(5000);  // 6 seconds countdown

  tft.fillScreen(TFT_BLACK);
  tft.setCursor(80, 30);
  tft.fillScreen(TFT_GREEN);
  tft.setCursor(80, 30);
  tft.setTextColor(TFT_BLACK);
  tft.print("Kalibrasi Berhasil");
  delay(1000);
}

void countdown(int ms) {
  for (int i = ms / 1000; i >= 0; i--) {
    tft.setCursor(60, 60);                     // Adjust the position as needed
    tft.fillRect(60, 60, 240, 20, TFT_BLACK);  // Clear the previous countdown text
    tft.setTextColor(TFT_WHITE);
    tft.setTextSize(2);
    tft.print("Waktu tersisa: ");
    tft.print(i);
    tft.print(" detik");
    delay(1000);
  }
  // tft.fillRect(60, 60, 240, 40, TFT_BLACK);  // Clear the countdown text after the loop
  delay(1000);
  tft.fillScreen(TFT_BLACK);
}

void tareScale() {
  tft.setCursor(120, 170);
  tft.setTextSize(2);
  tft.print("Tare Scaling");
  scale.tare();
  delay(1000);
  tft.setCursor(165, 190);
  tft.print("Done");
  delay(500);
}

void printWeight() {
  tft.setCursor(140, 170);
  tft.setTextSize(2);
  tft.print("Printing");

  float stableWeight = getStableWeight();

  char weightStr[10];
  dtostrf(stableWeight / 1000.0, 6, 3, weightStr);  // Convert to kilograms for display

  // Inisialisasi koneksi SoftwareSerial untuk printer
  // SoftwareSerial mySerial(RX_PIN, TX_PIN);
  // mySerial.begin(9600);

  PRINTER.print("^XA");       // Start of label format
  PRINTER.print("^PW380");    // Set label width in dots (2.8 cm * 203 dpi = 560 dots)
  PRINTER.print("^LL800");    // Set label length in dots (5.3 cm * 203 dpi = 800 dots)
  PRINTER.print("^FO20,20");  // Set origin of text

  // Set font size for the first line
  PRINTER.print("^A0N,27,27");  // Set font: Font A, size 30

  // Print the first line
  PRINTER.print("^FDPT NIHON SEIKI INDONESIA^FS");  // Print text

  // Second line (adjusted position and font)
  PRINTER.print("^FO20,100");    // Set origin of second line
  PRINTER.print("^A0N,40,40");   // Set font for second line (Font A, size 40)
  PRINTER.print("^FDWeight: ");  // Print second line text
  PRINTER.print(weightStr);      // Print the current weight
  PRINTER.print(" Kg^FS");

  PRINTER.print("^XZ");  // End of label format
  delay(1500);
  tft.setCursor(165, 190);
  tft.print("Done");
  delay(500);
}

float roundToNearest(float value, float resolution) {
  return round(value / resolution) * resolution;
}

float getStableWeight() {
  const int numReadings = 1;
  float readings[numReadings];
  float total = 0;

  for (int i = 0; i < numReadings; i++) {
    readings[i] = scale.get_units(10);
    total += readings[i];
  }

  float average = total / numReadings;

  // Membulatkan nilai average sesuai dengan digit terakhirnya
  average = roundToNearest(average, 0.1);

  // Memastikan bahwa nilai stableWeight tidak kurang dari
  float stableWeight = (average <= 3) ? 0 : average;


  if (average <= 3) {
    stableWeight = 0;
  } else if (average > 198 && average < 202) {
    stableWeight = 200;
  } else {
    stableWeight = average;
  }

  return stableWeight;
}

void loop() {
  if (digitalRead(BTN_PIN) == LOW) {
    if (!buttonPressed) {
      buttonPressed = true;
      buttonPressStartTime = millis();
    }
  } else {
    if (buttonPressed) {
      buttonPressed = false;
      unsigned long pressDuration = millis() - buttonPressStartTime;

      float stableWeight = getStableWeight();

      if (pressDuration >= 8000) {
        calibrateScale();
      } else if (pressDuration >= 5000 && pressDuration < 8000) {
        tareScale();
      } else if (pressDuration > 0 && pressDuration < 5000) {
        if (stableWeight >= BATAS_BAWAH && stableWeight <= BATAS_ATAS) {
          printWeight();
        } else {
          tft.setCursor(70, 170);
          tft.setTextSize(2);
          tft.print("Tidak Dapat Di Print");
          delay(2000);
        }
      }
    }
  }

  float stableWeight = getStableWeight();

  char weightStr[10];
  dtostrf(stableWeight / 1000.0, 6, 3, weightStr);

  if (stableWeight <= 1) {
    digitalWrite(BUZZER, MATI);
    tft.fillScreen(TFT_BLACK);
    tft.setTextColor(TFT_WHITE);
  } else if (stableWeight > 198 && stableWeight < 202) {
    digitalWrite(BUZZER, MATI);
    tft.fillScreen(TFT_BLUE);
    tft.setTextColor(TFT_WHITE);
    tft.setCursor(110, 60);
    tft.setTextSize(2);
    tft.print("Verifikasi Berhasil");
  } else if (stableWeight < (BATAS_BAWAH - 1)) {
    digitalWrite(BUZZER, NYALA);
    delay(500);
    digitalWrite(BUZZER, MATI);
    tft.fillScreen(TFT_RED);
    tft.setTextColor(TFT_WHITE);
  } else if (stableWeight >= BATAS_BAWAH && stableWeight <= BATAS_ATAS) {
    digitalWrite(BUZZER, MATI);
    tft.fillScreen(TFT_GREEN);
    tft.setTextColor(TFT_BLACK);
  } else if (stableWeight > (BATAS_ATAS - 1)) {
    digitalWrite(BUZZER, NYALA);
    delay(500);
    digitalWrite(BUZZER, MATI);
    tft.fillScreen(TFT_RED);
    tft.setTextColor(TFT_WHITE);
  }

  tft.fillRect(30, 100, 0, 0, TFT_BLACK);

  tft.setCursor(30, 100);
  tft.setTextSize(6);
  tft.print(weightStr);
  tft.print(" Kg");
}